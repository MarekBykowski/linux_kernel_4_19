## Documentation/devicetree/bindings/arm/axxia.txt
```
INTEL Axxia AXM55xx device tree bindings

Boards using the AXM55xx SoC need to have the following properties:

Required root node property:

  - compatible = "axxia,axm5516"

Boards:

  INTEL Axxia AXM5516 Validation board (Amarillo)
	compatible = "axxia,axm5516-amarillo", "axxia,axm5516"
```

## drivers/misc/mb_tests/Kconfig
```kconfig
menu "Marek Bykowski's testing modules"

comment "Marek Bykowski's testing modules."

config PROCESS_TASK 
	tristate "Inspect processes running kernels"
	default m
	---help---
		List tasks and see how current process is being found

endmenu
```

## multi1_axc.its
```
/dts-v1/;
/ {
    description = "multi.fit";
    #address-cells = <1>;

    images {
        kernel {
            description = "Linux Kernel";
            data = /incbin/("vmlinux.bin.gz");
            type = "kernel";
            arch = "arm64";
            os = "linux";
            compression = "gzip";
            load = <0x80000>;
            entry = <0x80000>;
            hash1 {
                algo = "crc32";
            };
            hash2 {
                algo = "sha1";
            };
        };

    };

    configurations {
        default = "conf";
        conf {
            description = "multi.fit with kernel for XLF";
            kernel = "kernel";
        };
    };
};
```

## multi2_axm55.its
```
/dts-v1/;
/ {
    description = "multi.fit";
    #address-cells = <1>;

    images {
        kernel {
            description = "Linux Kernel";
            data = /incbin/("vmlinux.bin.gz");
            type = "kernel";
            arch = "arm";
            os = "linux";
            compression = "gzip";
            load = <0x408000>;
            entry = <0x408000>;
            hash1 {
                algo = "crc32";
            };
            hash2 {
                algo = "sha1";
            };
        };

        fdt {
            description = "Flattened Device Tree blob";
            data = /incbin/("arch/arm/boot/dts/axm5516-amarillo.dtb");
            type = "flat_dt";
            arch = "arm";
            compression = "none";
            hash1 {
                algo = "crc32";
            };
            hash2 {
                algo = "sha1";
            };
        };
    };

    configurations {
        default = "conf";
        conf {
            description = "multi.fit for axm5516";
            kernel = "kernel";
            fdt = "fdt";
        };
    };
};
```

## multi2_axm56.its
```
/dts-v1/;
/ {
    description = "multi.fit";
    #address-cells = <1>;

    images {
        kernel {
            description = "Linux Kernel";
            data = /incbin/("vmlinux.bin.gz");
            type = "kernel";
            arch = "arm64";
            os = "linux";
            compression = "gzip";
            load = <0x80000>;
            entry = <0x80000>;
            hash1 {
                algo = "crc32";
            };
            hash2 {
                algo = "sha1";
            };
        };

        fdt {
            description = "Flattened Device Tree blob";
            data = /incbin/("arch/arm64/boot/dts/intel/axm5616-victoria.dtb");
            type = "flat_dt";
            arch = "arm64";
            compression = "none";
            hash1 {
                algo = "crc32";
            };
            hash2 {
                algo = "sha1";
            };
        };
    };

    configurations {
        default = "conf";
        conf {
            description = "multi.fit for X9";
            kernel = "kernel";
            fdt = "fdt";
        };
    };
};
```

## multi3_axm56.its
```
/dts-v1/;
/ {
    description = "multi.fit";
    #address-cells = <1>;

    images {
        kernel {
            description = "Linux Kernel";
            data = /incbin/("vmlinux.bin.gz");
            type = "kernel";
            arch = "arm64";
            os = "linux";
            compression = "gzip";
            load = <0x80000>;
            entry = <0x80000>;
            hash1 {
                algo = "crc32";
            };
            hash2 {
                algo = "sha1";
            };
        };

        fdt {
            description = "Flattened Device Tree blob";
            data = /incbin/("arch/arm64/boot/dts/intel/axm5616-victoria.dtb");
            type = "flat_dt";
            arch = "arm64";
            compression = "none";
            hash1 {
                algo = "crc32";
            };
            hash2 {
                algo = "sha1";
            };
        };

        ramdisk {
            description = "ramdisk";
            /*data = /incbin/("./axxia-image-small-axxiaarm64-20190523121650.rootfs.tar.gz");*/
            /*data = /incbin/("./core-image-minimal-axxiaarm64-20190523120840.rootfs.cpio.gz");*/
			/*data = /incbin/("./image.cpio.gz");*/
			/*data = /incbin/("./imagefile.img");*/
			data = /incbin/("./ramdisk.img.gz");
            type = "ramdisk";
            arch = "arm64";
            os = "linux";
            compression = "gzip";
            load = <00000000>;
            entry = <00000000>;
            hash {
                algo = "crc32";
            };
        };
    };


    configurations {
        default = "conf";
        conf {
            description = "multi.fit for X9";
            kernel = "kernel";
            fdt = "fdt";
			ramdisk = "ramdisk";
        };
    };
};
```
