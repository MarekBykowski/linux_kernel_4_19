## drivers/misc/mb_labs/Kconfig
```kconfig
menu "Marek Bykowski's kernel labs"

source "drivers/misc/mb_labs/vma_lab/Kconfig"
source "drivers/misc/mb_labs/mmap_lab/Kconfig"

config MB_LAB_PROCFS
	tristate "procfs lab: boolean knob at /proc/my_bool"
	default m
	help
	  Creates /proc/my_bool with read and write handlers. Exercises
	  proc_create(), copy_to_user() and kstrtoint_from_user().

config MB_LAB_COMPLETION
	tristate "completion lab: wait for a worker kthread"
	default m
	help
	  Starts a kthread and blocks in wait_for_completion() until the
	  worker signals complete().

config MB_LAB_WAITQUEUE
	tristate "waitqueue lab: producer/consumer"
	default m
	help
	  A consumer kthread sleeps in wait_event() until a producer
	  kthread sets the condition and calls wake_up().

config MB_LAB_WORKQUEUE
	tristate "workqueue lab: deferred work on an own workqueue"
	default m
	help
	  Allocates a dedicated workqueue and queues a work item embedded
	  in an object, recovered in the handler via container_of().

config MB_LAB_RADIX_TREE
	tristate "radix tree lab: sparse array of pointers"
	default m
	help
	  Stores pointers at sparse indices (including a billion) and
	  iterates the tree. The XArray that replaced the radix tree in
	  v4.20 offers the same semantics.

config MB_LAB_RCU
	tristate "rcu lab: lockless reader vs pointer-swapping writer"
	default m
	help
	  A reader kthread dereferences a shared pointer under
	  rcu_read_lock() while a writer kthread replaces it with
	  rcu_assign_pointer() and reclaims via synchronize_rcu().

config MB_LAB_LOCKING
	tristate "locking lab: spinlock vs mutex contention"
	default m
	help
	  Kthreads hammer shared counters under a spinlock and a mutex.
	  Load with sleep_in_atomic=1 to sleep under the spinlock and let
	  CONFIG_DEBUG_ATOMIC_SLEEP call out the bug.

config MB_LAB_LOCKDEP
	tristate "lockdep lab: ABBA ordering caught by PROVE_LOCKING"
	default m
	help
	  Takes two mutexes in A->B then B->A order. With
	  CONFIG_PROVE_LOCKING lockdep prints a circular-dependency splat
	  even though no deadlock actually occurs.

config MB_LAB_ATOMICS
	tristate "atomics lab: lost updates with plain int vs atomic_t"
	default m
	help
	  Two kthreads increment a plain int and an atomic_t a million
	  times each; the plain counter visibly loses updates on SMP.

config MB_LAB_PTWALK
	tristate "page-table walk lab: resolve a user VA by hand"
	default m
	help
	  Walks pgd -> pud -> pmd -> pte for a target process's
	  start_code and start_stack, printing each level, the physical
	  address and the PTE attribute bits.

config MB_LAB_KPROBE
	tristate "kprobes lab: probe do_sys_open on a live kernel"
	default m
	help
	  Registers a kprobe on do_sys_open() and logs the first few
	  hits with the opener's comm; prints the total on unload.

config MB_LAB_SEQLOCK
	tristate "seqlock lab: lockless readers that retry"
	default m
	help
	  A writer updates a two-field value under write_seqlock() while
	  a lockless reader retries on read_seqretry(), never observing
	  a torn read.

config MB_LAB_SYSREG
	tristate "sysreg lab: arm64 system registers in procfs"
	default m
	help
	  Reads MIDR_EL1, MPIDR_EL1, CNTVCT_EL0, CNTFRQ_EL0 and
	  CurrentEL with mrs and presents them decoded at
	  /proc/mb_sysregs.

config MB_LAB_IRQTHREAD
	tristate "threaded IRQ lab: top half + threaded bottom half"
	depends on IRQ_SIM
	default m
	help
	  Uses the kernel IRQ simulator to hand out a real irq with no
	  hardware, then request_threaded_irq()s it: the primary handler
	  runs in interrupt context and wakes a thread_fn that runs in its
	  own kthread and may sleep. Fired from software with
	  irq_sim_fire().

config MB_LAB_CURRENT
	tristate "current lab: who is `current`, via SP_EL0"
	default m
	help
	  Reports `current` from module init (the modprobe task), a
	  kthread (its own task, no user mm) and a hardirq (the
	  interrupted task), confirming on arm64 that current equals
	  SP_EL0 each time.

config MB_LAB_CONTEXT
	tristate "context lab: report the kernel execution contexts"
	default m
	help
	  Runs one reporting function from process, softirq (tasklet) and
	  hardirq (hrtimer) context, printing the preempt_count and
	  in_task/in_softirq/in_irq/in_nmi flags side by side.

config MB_LAB_IPI
	tristate "IPI lab: interrupt a chosen CPU and run a callback"
	default m
	help
	  smp_call_function_single() sends a GIC SGI to the CPU given by
	  the cpu= parameter; the callback runs there in hard interrupt
	  context and reports what it interrupted.

config MB_LAB_HRTIMER
	tristate "hrtimer lab: periodic timer with jitter measurement"
	default m
	help
	  Arms a 100 ms periodic hrtimer that re-arms itself with
	  hrtimer_forward_now() and reports each expiry's jitter.

endmenu
```

## drivers/misc/mb_labs/mb_vma_lab/Kconfig
```kconfig
config PROCESS_TASK
	tristate "vma lab: kernel vs userspace view of an address space"
	default m
	help
	  The kernel_addr module walks the VMAs of the process given by
	  pid_mem= and prints its code/data/stack segments, to be compared
	  against the process's own view printed by the user_addr tool
	  in the same directory.
```

## drivers/misc/mb_labs/mmap_lab/Kconfig
```kconfig
config MB_LAB_MMAP
	tristate "mmap lab: share a kernel page with userspace"
	default m
	help
	  A misc device whose .mmap remaps a kernel page into the calling
	  process with remap_pfn_range(). The user_mmap tool in the same
	  directory maps it, reads the kernel's message and writes one
	  back through the shared physical page.
```

## drivers/misc/mb_labs/procthread_lab/Kconfig
```kconfig
config MB_LAB_PROCTHREAD
	tristate "concurrency lab: char device hammered by threads + processes"
	default m
	help
	  A misc device /dev/mb_procthread whose write() bumps a mutex-protected
	  counter. The user_procthread tool drives it from pthreads and fork()'d
	  processes at once; the counter stays exact, and each open() logs
	  pid/tgid so you see the kernel's thread-vs-process view.
```
